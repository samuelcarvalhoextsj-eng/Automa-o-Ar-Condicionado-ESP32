#include <Arduino.h>
#include <WiFi.h>
#include <PubSubClient.h>
#include <IRremoteESP8266.h>
#include <IRsend.h>
#include "DHT.h"

// ==========================================
// 1. CONFIGURAÇÕES DE REDE E MQTT
// ==========================================
const char* ssid = "Celso";       // <-- COLOQUE SEU WIFI
const char* password = "Nathalia29";  // <-- COLOQUE SUA SENHA
const char* mqtt_server = "broker.hivemq.com";   // Broker público

// Tópicos MQTT 
const char* topico_comando_ar = "sala/ar/comando";        
const char* topico_temp = "sala/sensores/temperatura";    
const char* topico_umidade = "sala/sensores/umidade";     
const char* topico_presenca = "sala/sensores/presenca";   

WiFiClient espClient;
PubSubClient client(espClient);

// ==========================================
// 2. PINOS DOS SENSORES E IR
// ==========================================
const uint16_t PINO_LED_IR = 14; 
#define DHTPIN 4                 
#define DHTTYPE DHT11            
const int PIR_PIN = 19;          

IRsend irsend(PINO_LED_IR);
DHT dht(DHTPIN, DHTTYPE);

unsigned long tempoAnteriorDHT = 0;
int estadoPirAnterior = LOW;

// ==========================================
// 3. ARRAYS DE INFRAVERMELHO (Corrigidos com [])
// ==========================================

uint16_t rawDesligar[] = {708, 17776, 3046, 8920, 516, 510, 504, 1454, 538, 486, 538, 434, 562,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 1458, 518};

uint16_t raw18[] = {660, 17770, 3068, 8898, 514, 482, 486, 1502, 534, 464, 544, 452, 486,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 1450, 480};

uint16_t raw20[] = {658, 17770, 3042, 8926, 532, 468, 534, 1450, 544, 456, 566, 428, 568,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 1444, 570};

uint16_t raw22[] = {658, 17772, 3094, 8874, 532, 466, 486, 1508, 544, 448, 544, 452, 542,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 1446, 1464};

uint16_t raw24[] = {658, 17772, 3044, 8922, 492, 504, 534, 1450, 544, 454, 566, 428, 568,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 1446, 572};

// ==========================================
// 4. FUNÇÃO QUE RECEBE COMANDOS DO MQTT
// ==========================================
void callbackMQTT(char* topic, byte* payload, unsigned int length) {
  String mensagem = "";
  for (int i = 0; i < length; i++) {
    mensagem += (char)payload[i];
  }
  
  Serial.print("Comando recebido [");
  Serial.print(topic);
  Serial.print("]: ");
  Serial.println(mensagem);

  // A MÁGICA: O C++ agora calcula sozinho o tamanho do array com o "sizeof"
  if (mensagem == "DESLIGAR") {
    Serial.println(">>> Enviando IR: DESLIGAR...");
    int tamanho = sizeof(rawDesligar) / sizeof(rawDesligar[0]);
    irsend.sendRaw(rawDesligar, tamanho, 38); 
  } 
  else if (mensagem == "LIGAR_18") {
    Serial.println(">>> Enviando IR: LIGAR EM 18ºC (TURBO)...");
    int tamanho = sizeof(raw18) / sizeof(raw18[0]);
    irsend.sendRaw(raw18, tamanho, 38);
  }
  else if (mensagem == "LIGAR_20") {
    Serial.println(">>> Enviando IR: LIGAR EM 20ºC...");
    int tamanho = sizeof(raw20) / sizeof(raw20[0]);
    irsend.sendRaw(raw20, tamanho, 38);
  }
  else if (mensagem == "LIGAR_22") {
    Serial.println(">>> Enviando IR: LIGAR EM 22ºC (CONFORTO)...");
    int tamanho = sizeof(raw22) / sizeof(raw22[0]);
    irsend.sendRaw(raw22, tamanho, 38);
  }
  else if (mensagem == "LIGAR_24") {
    Serial.println(">>> Enviando IR: LIGAR EM 24ºC (ECONÔMICO)...");
    int tamanho = sizeof(raw24) / sizeof(raw24[0]);
    irsend.sendRaw(raw24, tamanho, 38);
  }
}

// ==========================================
// 5. FUNÇÃO PARA CONECTAR NO WIFI E MQTT
// ==========================================
void reconectarMQTT() {
  while (!client.connected()) {
    Serial.print("Tentando conectar ao broker MQTT...");
    String clientId = "ESP32Sala-" + String(WiFi.macAddress()); // Usa o MAC para ser 100% único
    clientId += String(random(0xffff), HEX);
    
    if (client.connect(clientId.c_str())) {
      Serial.println("Conectado!");
      client.subscribe(topico_comando_ar);
    } else {
      Serial.print("Falha, rc=");
      Serial.print(client.state());
      Serial.println(" Tentando novamente em 5 segundos...");
      delay(5000);
    }
  }
}

// ==========================================
// 6. SETUP 
// ==========================================
void setup() {
  Serial.begin(115200);
  
  pinMode(PIR_PIN, INPUT);
  irsend.begin();
  dht.begin();

  Serial.println();
  Serial.print("Conectando ao WiFi ");
  Serial.println(ssid);
  WiFi.begin(ssid, password);
  
  while (WiFi.status() != WL_CONNECTED) {
    delay(500);
    Serial.print(".");
  }
  Serial.println("\nWiFi conectado! IP: ");
  Serial.println(WiFi.localIP());

  // No final do Setup():
// Força o ESP32 a entender que isso é um IP numérico puro (bypassa o DNS)
  client.setServer(mqtt_server, 1883);
  client.setCallback(callbackMQTT);
}

// ==========================================
// 7. LOOP 
// ==========================================
void loop() {
  if (!client.connected()) {
    reconectarMQTT();
  }
  client.loop(); 

  unsigned long tempoAtual = millis();

  // ----- LEITURA DO DHT11 (A CADA 5 SEGUNDOS) -----
  if (tempoAtual - tempoAnteriorDHT >= 5000) {
    tempoAnteriorDHT = tempoAtual;
    
    float temp = dht.readTemperature();
    float umid = dht.readHumidity();

    if (!isnan(temp) && !isnan(umid)) {
      client.publish(topico_temp, String(temp).c_str());
      client.publish(topico_umidade, String(umid).c_str());
    }
  }

  // ----- LEITURA DO PIR (EM TEMPO REAL) -----
  int estadoPirAtual = digitalRead(PIR_PIN);
  if (estadoPirAtual != estadoPirAnterior) {
    if (estadoPirAtual == HIGH) {
      Serial.println("Movimento detectado!");
      client.publish(topico_presenca, "MOVIMENTO");
    } else {
      Serial.println("Sala vazia...");
      client.publish(topico_presenca, "VAZIO");
    }
    estadoPirAnterior = estadoPirAtual;
  }
}